## main/Kconfig.projbuild
```kconfig
menu "Wi-Fi configuration"

    config WIFI_SSID
        string "Wi-Fi network name (SSID)"
        default ""
        help
            The network the board joins at boot. Keep the default empty until
            you set it: this value ends up in sdkconfig, which is not committed.

    config WIFI_PASSWORD
        string "Wi-Fi password"
        default ""
        help
            Leave empty for an open network.

endmenu

menu "Audio"

    config AUDIO_SELF_TEST
        bool "Run the audio hardware self-test at boot"
        default n
        help
            Plays a one-second 440 Hz tone and then logs the microphone level
            for four seconds. Useful when checking a new board's audio path.
            The test runs in its own task so it does not delay network startup,
            but it does make sound on every boot, so leave this off normally.

endmenu

menu "Reply player"

    config PLAYER_TEST_URL
        string "URL to play once after Wi-Fi connects (empty disables the test)"
        default ""
        help
            Fetches and plays this URL once after the board gets an IP address,
            then does nothing. It is only a hardware check for the HTTP and
            decode path (for example http://192.168.10.4:8085/tone.wav), because
            the real session layer decides when a reply is played. Leave it
            empty in normal builds; the test makes sound on every boot.

endmenu

menu "Voice session"

    config SESSION_SIMULATED_TRIGGER
        bool "Raise a simulated wake word trigger after a client connects"
        default n
        help
            Bench test only. Three seconds after an ESPHome API client
            connects, start a session as if the wake word had been detected.
            This lets the streaming, error and return-to-idle paths be
            exercised without touching the board; with no speech the client
            answers "No speech detected". Leave this off in normal builds.

endmenu
```
